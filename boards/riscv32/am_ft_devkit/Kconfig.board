## boards/riscv32/am_ft_devkit/Kconfig.board
```kconfig
config BOARD_AM_FT_DEVKIT
	bool "am_ft_devkit target"
	depends on SOC_RISCV32_FE310
```

## boards/riscv32/am_ft_devkit/Kconfig.defconfig
```kconfig
if BOARD_AM_FT_DEVKIT

config BOARD
	default "am_ft_devkit"

config RISCV_ROM_BASE_ADDR
    default 0x60000000

config RISCV_ROM_SIZE
    default 0x00010000

config RISCV_RAM_BASE_ADDR
    default 0x60010000

config RISCV_RAM_SIZE
    default 0x04000000

endif
```

## boards/riscv32/am_ft_devkit/am_ft_devkit_defconfig
```kconfig
CONFIG_RISCV32=y
CONFIG_SOC_SERIES_RISCV32_FE310=y
CONFIG_SOC_RISCV32_FE310=y
CONFIG_BOARD_AM_FT_DEVKIT=y
CONFIG_CONSOLE=y
CONFIG_PRINTK=y
CONFIG_SERIAL=y
CONFIG_UART_CONSOLE=y
CONFIG_UART_CONSOLE_ON_DEV_NAME="uart0"
CONFIG_PLIC_FE310=y
#CONFIG_PINMUX=y
#CONFIG_PINMUX_FE310=y
CONFIG_RISCV_MACHINE_TIMER=y
#CONFIG_GPIO=y
#CONFIG_GPIO_FE310=y
CONFIG_BOOT_BANNER=y

CONFIG_UART_AXI_LITE=y
```

## drivers/serial/Kconfig.axi_lite
```kconfig
menuconfig UART_AXI_LITE
	bool "AXI UART Lite driver"
	default n
	select SERIAL_HAS_DRIVER
	help
	Enable the AXI UART Lite driver.
```
